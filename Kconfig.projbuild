## Kconfig.projbuild
```kconfig
menu "Koios SDK Configuration"

    choice KOIOS_SDK_MALLOC_TARGET
        prompt "Large buffer allocation target"
        default KOIOS_SDK_MALLOC_SPIRAM if SPIRAM
        default KOIOS_SDK_MALLOC_INTERNAL
        help
            Where message buffers (WebSocket rx/tx, tokens, certs) are
            allocated. SPIRAM keeps internal RAM free for TLS handshakes.

        config KOIOS_SDK_MALLOC_INTERNAL
            bool "Internal RAM"

        config KOIOS_SDK_MALLOC_SPIRAM
            bool "SPIRAM"
            depends on SPIRAM

    endchoice

    config KOIOS_SDK_WS_TASK_STACK
        int "WebSocket task stack size (bytes)"
        default 10240
        help
            Stack for esp_websocket_client's task. Cloudlink dispatches the
            app's on_message / control-frame callbacks on this task, so it
            must cover the TLS record path PLUS whatever the app's handlers
            do (protobuf unpack, NVS writes). Raise it if you see a stack
            overflow in "websocket_task".

    config KOIOS_SDK_LOGS_ENABLE
        bool "Ship device logs to Koios (over the cloudlink websocket)"
        default n
        help
            Capture every ESP_LOGx line, buffer it in RTC-retained memory so
            it survives resets/brownouts/deep sleep, and stream batches to the
            Koios gateway as a {"type":"logs",...} control frame over the
            existing cloudlink websocket. The frame rides the already-
            authenticated device session, so there is no bearer token and no
            `logs.write` capability to grant. Off by default; when disabled,
            no capture hook, task, or RTC footprint is added.

    if KOIOS_SDK_LOGS_ENABLE

        config KOIOS_SDK_LOGS_RTC_BYTES
            int "RTC log ring size (bytes)"
            default 2048
            range 512 8192
            help
                Size of the RTC-retained byte ring that buffers log lines while
                the websocket is down (when it is up, lines ship as they
                arrive). Variable-length records are packed in; the oldest are
                evicted when it fills. Lives in RTC slow memory, which is small
                (~8 KiB on the ESP32-S3) and shared, so keep it modest.

        config KOIOS_SDK_LOGS_TAG_LEN
            int "Max stored tag length (bytes, incl. NUL)"
            default 16
            range 8 32

        config KOIOS_SDK_LOGS_MSG_LEN
            int "Max stored message length (bytes, incl. NUL)"
            default 160
            range 32 512
            help
                Longer lines are truncated in the RTC ring. Keep modest — it
                multiplies by the ring capacity against RTC memory.

        config KOIOS_SDK_LOGS_FLUSH_INTERVAL_MS
            int "Retry/fallback interval (ms)"
            default 60000
            help
                Lines ship as they arrive while the session is ready. This
                interval only bounds how long a backlog waits after a failed
                send, or before the session first comes up.

        config KOIOS_SDK_LOGS_BODY_BYTES
            int "Max log frame body (bytes)"
            default 16384
            help
                Upper bound on a single log control frame; larger backlogs ship
                across several frames. Allocated once from the SDK buffer pool.

    endif

endmenu
```
